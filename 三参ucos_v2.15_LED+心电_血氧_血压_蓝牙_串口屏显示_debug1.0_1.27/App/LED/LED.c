/*********************************************************************************************************
* 模块名称：LED.c
* 摘    要：LED模块
* 当前版本：1.0.0
* 作    者：Leyutek(COPYRIGHT 2018 - 2021 Leyutek. All rights reserved.)
* 完成日期：2021年07月01日
* 内    容：
* 注    意：                                                                  
**********************************************************************************************************
* 取代版本：
* 作    者：
* 完成日期：
* 修改内容：
* 修改文件：
*********************************************************************************************************/

/*********************************************************************************************************
*                                              包含头文件
*********************************************************************************************************/
#include "LED.h"
#include "gd32f30x_conf.h"

/*********************************************************************************************************
*                                              宏定义
*********************************************************************************************************/

/*********************************************************************************************************
*                                              枚举结构体定义
*********************************************************************************************************/

/*********************************************************************************************************
*                                              内部变量
*********************************************************************************************************/
//LED任务
OS_TCB g_tcbLEDTask;               //任务控制块
static CPU_STK s_arrLEDStack[128]; //任务栈区
/*********************************************************************************************************
*                                              内部函数声明
*********************************************************************************************************/
static  void  ConfigLEDGPIO(void);  //配置LED的GPIO
static  void  LEDTask(void *pArg);
/*********************************************************************************************************
*                                              内部函数实现
*********************************************************************************************************/
/*********************************************************************************************************
* 函数名称：ConfigLEDGPIO
* 函数功能：配置LED的GPIO 
* 输入参数：void 
* 输出参数：void
* 返 回 值：void
* 创建日期：2021年07月01日
* 注    意：
*********************************************************************************************************/
static  void  ConfigLEDGPIO(void)
{
  //使能RCU相关时钟
  rcu_periph_clock_enable(RCU_GPIOC);  //使能GPIOA的时钟
  
  gpio_init(GPIOC, GPIO_MODE_OUT_PP, GPIO_OSPEED_50MHZ, GPIO_PIN_8);  //设置GPIO输出模式及速度
  gpio_bit_set(GPIOC,GPIO_PIN_8);                                     //将LED1默认状态设置为点亮
  
  gpio_init(GPIOC, GPIO_MODE_OUT_PP, GPIO_OSPEED_50MHZ, GPIO_PIN_9);  //设置GPIO输出模式及速度
  gpio_bit_reset(GPIOC,GPIO_PIN_9);                                   //将LED2默认状态设置为熄灭
}

/*********************************************************************************************************
*                                              API函数实现
*********************************************************************************************************/
/*********************************************************************************************************
* 函数名称：InitLED
* 函数功能：初始化LED模块
* 输入参数：void
* 输出参数：void
* 返 回 值：void
* 创建日期：2021年07月01日
* 注    意：
*********************************************************************************************************/
void InitLED(void)
{
  //任务信息结构体
  typedef struct
  {
    OS_TCB*      tcb;     //任务控制块
    OS_TASK_PTR  func;    //任务热口地址
    CPU_CHAR*    name;    //任务名字
    OS_PRIO      prio;    //任务优先级
    CPU_STK*     stkBase; //任务栈区基地址
    CPU_STK_SIZE stkSize; //栈区大小
    OS_MSG_QTY   queSize; //内建消息队列容量
  }StructTaskInfo;

  //任务列表
  StructTaskInfo taskInfo[] = 
  {
    {&g_tcbLEDTask, LEDTask, "LEDtask", 25, s_arrLEDStack, sizeof(s_arrLEDStack) / sizeof(CPU_STK), 0},
  };
  
  //局部变量
  unsigned int i;
  OS_ERR err;
  
  //硬件配置
  ConfigLEDGPIO();  //配置LED的GPIO
  
  //创建任务
  for(i = 0; i < sizeof(taskInfo) / sizeof(StructTaskInfo); i++)
  {
    OSTaskCreate((OS_TCB*)taskInfo[i].tcb,
                 (CPU_CHAR*)taskInfo[i].name,
                 (OS_TASK_PTR)taskInfo[i].func,
                 (void*)0,
                 (OS_PRIO)taskInfo[i].prio,
                 (CPU_STK*)taskInfo[i].stkBase,
                 (CPU_STK_SIZE)taskInfo[i].stkSize / 10,
                 (CPU_STK_SIZE)taskInfo[i].stkSize,
                 (OS_MSG_QTY)taskInfo[i].queSize,
                 (OS_TICK)0,
                 (void*)0,
                 (OS_OPT)OS_OPT_TASK_STK_CHK | OS_OPT_TASK_STK_CLR | OS_OPT_TASK_SAVE_FP,
                 (OS_ERR*)&err
                );

    //校验
    if(OS_ERR_NONE != err)
    {
      printf("Fail to create %s (%d)\r\n", taskInfo[i].name, err);
      while(1){}
    }
  }
}

/*********************************************************************************************************
* 函数名称：LEDFlicker
* 函数功能：LED闪烁函数
* 输入参数：cnt
* 输出参数：void
* 返 回 值：void
* 创建日期：2021年07月01日
* 注    意：LEDFlicker在Proc2msTask中调用，cnt为250时表示每500ms更改一次LED状态
*********************************************************************************************************/
static void LEDTask(void *pArg)
{
  OS_ERR err;
  while(1)
  {
    //LED1状态取反，实现LED1闪烁
    gpio_bit_write(GPIOC, GPIO_PIN_8, (FlagStatus)(1 - gpio_output_bit_get(GPIOC, GPIO_PIN_8)));

    //LED2状态取反，实现LED2闪烁
    gpio_bit_write(GPIOC, GPIO_PIN_9, (FlagStatus)(1 - gpio_output_bit_get(GPIOC, GPIO_PIN_9)));
    OSTimeDlyHMSM(0, 0, 0, 500, OS_OPT_TIME_HMSM_STRICT, &err);
  }
}
