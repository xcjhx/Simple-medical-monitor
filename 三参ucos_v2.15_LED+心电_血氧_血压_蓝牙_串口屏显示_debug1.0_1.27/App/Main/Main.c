/*********************************************************************************************************
* 模块名称：Main.c
* 摘    要：主文件，包含软硬件初始化函数和main函数
* 当前版本：1.0.0
* 作    者：Leyutek(COPYRIGHT 2018 - 2021 Leyutek. All rights reserved.)
* 完成日期：2021年07月01日
* 内    容：
* 注    意：
*          1、注意勾选Options for Target 'Target1'->Code Generation->Use MicroLIB，否则printf无法使用
*          2、在Options for Target 'Target1'->C/C++->Optimization将编译器优化等级调整到"Level0(-O0)"
*             能规避因为编译器优化带来的Bug
**********************************************************************************************************
* 取代版本：
* 作    者：
* 完成日期：
* 修改内容：
* 修改文件：
*********************************************************************************************************/

/*********************************************************************************************************
*                                              包含头文件
*********************************************************************************************************/
#include "Main.h"
#include "gd32f30x_conf.h"
#include "NVIC.h"
#include "UART0.h"
#include "UART1.h"
#include "UART2.h"
#include "LED.h"
#include "includes.h"
#include "Delay.h"
#include "ADC.h"
#include "ECG.h"
#include "SPO2.h"
#include "NIBP.h"
#include "Sprintf.h"
/*********************************************************************************************************
*                                              宏定义
*********************************************************************************************************/

/*********************************************************************************************************
*                                              内部变量
*********************************************************************************************************/
//开始任务
OS_TCB g_tcbStartTask;               //任务控制块
static CPU_STK s_arrStartStack[512]; //任务栈区
void StartTask(void *pArg);          //任务函数

/*********************************************************************************************************
*                                              枚举结构体定义
*********************************************************************************************************/

/*********************************************************************************************************
*                                              内部函数声明
*********************************************************************************************************/
static  void  InitSoftware(void);   //初始化软件相关的模块
static  void  InitHardware(void);   //初始化硬件相关的模块

/*********************************************************************************************************
*                                              内部函数实现
*********************************************************************************************************/
/*********************************************************************************************************
* 函数名称：InitSoftware
* 函数功能：所有的软件相关的模块初始化函数都放在此函数中
* 输入参数：void
* 输出参数：void
* 返 回 值：void
* 创建日期：2021年07月01日
* 注    意：
*********************************************************************************************************/
static  void  InitSoftware(void)
{
  InitLED();           //初始化LED模块
  InitECG();
  InitSPO2();
  InitNIBP();
  InitSprintf();
}

/*********************************************************************************************************
* 函数名称：InitHardware
* 函数功能：所有的硬件相关的模块初始化函数都放在此函数中
* 输入参数：void
* 输出参数：void
* 返 回 值：void
* 创建日期：2021年07月01日
* 注    意：
*********************************************************************************************************/
static  void  InitHardware(void)
{
  InitNVIC();          //初始化NVIC模块
  InitUART0(115200);   //初始化UART模块
  InitUART1(115200);   //初始化UART模块
  InitUART2(115200);   //初始化UART模块
  InitADC();
}

/*********************************************************************************************************
* 函数名称：main
* 函数功能：主函数
* 输入参数：void
* 输出参数：void
* 返 回 值：int
* 创建日期：2021年07月01日
* 注    意：
*********************************************************************************************************/
int main(void)
{
  OS_ERR err;

  //初始化UCOSIII
  OSInit(&err);
  if(OS_ERR_NONE != err)
  {
    printf("Fail to init OS (%d)\r\n", err);
    while(1){}
  }

  //创建开始任务
  OSTaskCreate((OS_TCB*)&g_tcbStartTask,                                       //任务控制块
               (CPU_CHAR*)"Start task",                                        //任务名字
               (OS_TASK_PTR)StartTask,                                         //任务函数
               (void*)0,                                                       //传递给任务函数的参数
               (OS_PRIO)3,                                                     //任务优先级
               (CPU_STK*)s_arrStartStack,                                      //任务栈区基地址
               (CPU_STK_SIZE)(sizeof(s_arrStartStack) / sizeof(CPU_STK)) / 10, //任务栈区深度限位
               (CPU_STK_SIZE)sizeof(s_arrStartStack) / sizeof(CPU_STK),        //任务栈区大小
               (OS_MSG_QTY)0,                                                  //禁用任务内部消息队列
               (OS_TICK)0,                                                     //时间片轮转时使用默认的时间片长度
               (void*)0,                                                       //用户补充的存储区
               (OS_OPT)OS_OPT_TASK_STK_CHK |                                   //任务选项，使能栈区使用量和剩余量计算
               OS_OPT_TASK_STK_CLR |                                           //任务选项，使能创建任务时初始化栈区
               OS_OPT_TASK_SAVE_FP,                                            //任务选项，使能保存浮点运算单元寄存器
               (OS_ERR*)&err);                                                 //存放该函数错误时的返回值
  if(OS_ERR_NONE != err)
  {
    printf("Fail to create start task (%d)\r\n", err);
    while(1){}
  }
  //开启UCOSIII
  OSStart(&err);
  if(OS_ERR_NONE != err)
  {
    printf("Fail to start OS (%d)\r\n", err);
    while(1){}
  }
  
  //不应该执行到这里
  while(1){}
}

/*********************************************************************************************************
* 函数名称: StartTask
* 函数功能: 开始任务任务函数
* 输入参数: pArg：任务参数
* 输出参数: void
* 返 回 值: void
* 创建日期: 2021年07月01日
* 注    意: 
*********************************************************************************************************/
void StartTask(void *pArg)
{
  //局部变量
  OS_ERR err;
  
  //OS常规初始化
  CPU_Init();      //初始化CPU模块
  Mem_Init();      //初始化内存管理模块
  Math_Init();     //初始化算术模块
  BSP_Tick_Init(); //初始化SysTick

  //CPU利用率统计初始化
#if OS_CFG_STAT_TASK_EN > 0u
   OSStatTaskCPUUsageInit(&err);
#endif

  //测量中断关闭时间初始化
#ifdef CPU_CFG_INT_DIS_MEAS_EN
  CPU_IntDisMeasMaxCurReset();
#endif

  //初始化时间片轮转调度功能
#if	OS_CFG_SCHED_ROUND_ROBIN_EN
  OSSchedRoundRobinCfg(DEF_ENABLED, 10, &err);
#endif

  //软硬件初始化
  InitHardware(); //初始化硬件相关函数
  InitSoftware(); //初始化软件相关函数
  printf("Init System has been finished\r\n");

  //删除开始任务
  OSTaskDel((OS_TCB*)&g_tcbStartTask, &err); 
}
