/*********************************************************************************************************
* 模块名称：Sprintf.c
* 摘    要：Sprintf模块
* 当前版本：1.0.0
* 作    者：Leyutek(COPYRIGHT 2018 - 2021 Leyutek. All rights reserved.)
* 完成日期：2021年07月01日
* 内    容：
* 注    意：                                                                  
**********************************************************************************************************
* 取代版本：
* 作    者：
* 完成日期：
* 修改内容：
* 修改文件：
*********************************************************************************************************/

/*********************************************************************************************************
*                                              包含头文件
*********************************************************************************************************/
#include "Sprintf.h"
#include "gd32f30x_conf.h"

/*********************************************************************************************************
*                                              宏定义
*********************************************************************************************************/

/*********************************************************************************************************
*                                              枚举结构体定义
*********************************************************************************************************/

/*********************************************************************************************************
*                                              内部变量
*********************************************************************************************************/
//打印任务
OS_TCB g_tcbPtintf;                   //任务控制块
static CPU_STK s_arrPrintfStack[1024]; //任务栈区
void Printf_task(void* pArg);              //任务函数

OS_Q g_quePrintQueue;
OS_MUTEX g_mutexTest;
/*********************************************************************************************************
*                                              内部函数声明
*********************************************************************************************************/
void printf_s_aus(char* str);
/*********************************************************************************************************
*                                              内部函数实现
*********************************************************************************************************/
/*********************************************************************************************************
* 函数名称:
* 函数功能: 打印任务
* 输入参数:
* 输出参数: void
* 返 回 值: void
* 创建日期: 2021年07月01日
* 注    意:
*********************************************************************************************************/
void Printf_task(void* pArg)
{
    char* pcMessageToPrint;
    OS_MSG_SIZE size;
    OS_ERR err;

    while (1)
    {
      
        //获取要打印的数据
        pcMessageToPrint = OSQPend(&g_quePrintQueue, 0, OS_OPT_PEND_BLOCKING, &size, NULL, &err);
        if (OS_ERR_NONE == err)
        {
            printf("%s", pcMessageToPrint);
        }

    }
}


/*********************************************************************************************************
*                                              API函数实现
*********************************************************************************************************/
/*********************************************************************************************************
* 函数名称：InitLED
* 函数功能：初始化LED模块
* 输入参数：void
* 输出参数：void
* 返 回 值：void
* 创建日期：2021年07月01日
* 注    意：
*********************************************************************************************************/
void InitSprintf(void)
{
  //任务信息结构体
  typedef struct
  {
    OS_TCB*      tcb;     //任务控制块
    OS_TASK_PTR  func;    //任务热口地址
    CPU_CHAR*    name;    //任务名字
    OS_PRIO      prio;    //任务优先级
    CPU_STK*     stkBase; //任务栈区基地址
    CPU_STK_SIZE stkSize; //栈区大小
    OS_MSG_QTY   queSize; //内建消息队列容量
  }StructTaskInfo;

  //任务列表
  StructTaskInfo taskInfo[] = 
  {
    {&g_tcbPtintf, Printf_task, "Printf_task", 60, s_arrPrintfStack, sizeof(s_arrPrintfStack) / sizeof(CPU_STK), 0},
  };
  
  //局部变量
  unsigned int i;
  OS_ERR err;
  
  //创建互斥量
  OSMutexCreate(&g_mutexTest, "mutex",&err);
  
  if(OS_ERR_NONE != err)
  {
    printf("Fail to creat mutex (%d)\r\n",err);
    while(1){}
  }
  
  //创建消息队列
  OSQCreate(&g_quePrintQueue,"打印",65535,&err);
  
  if(OS_ERR_NONE != err)
  {
    printf("Fail to creat OSQ (%d)\r\n",err);
    while(1){}
  }
  
  
  //创建任务
  for(i = 0; i < sizeof(taskInfo) / sizeof(StructTaskInfo); i++)
  {
    OSTaskCreate((OS_TCB*)taskInfo[i].tcb,
                 (CPU_CHAR*)taskInfo[i].name,
                 (OS_TASK_PTR)taskInfo[i].func,
                 (void*)0,
                 (OS_PRIO)taskInfo[i].prio,
                 (CPU_STK*)taskInfo[i].stkBase,
                 (CPU_STK_SIZE)taskInfo[i].stkSize / 10,
                 (CPU_STK_SIZE)taskInfo[i].stkSize,
                 (OS_MSG_QTY)taskInfo[i].queSize,
                 (OS_TICK)0,
                 (void*)0,
                 (OS_OPT)OS_OPT_TASK_STK_CHK | OS_OPT_TASK_STK_CLR | OS_OPT_TASK_SAVE_FP,
                 (OS_ERR*)&err
                );

    //校验
    if(OS_ERR_NONE != err)
    {
      printf("Fail to create %s (%d)\r\n", taskInfo[i].name, err);
      while(1){}
    }
  }
}

/*********************************************************************************************************
* 函数名称:
* 函数功能: 打印函数
* 输入参数:
* 输出参数: void
* 返 回 值: void
* 创建日期: 2021年07月01日
* 注    意:
*********************************************************************************************************/
void printf_s_aus(char* str)
{
    OS_ERR err;

    OSQPost(&g_quePrintQueue, str, 1, OS_OPT_POST_FIFO, &err);
}

